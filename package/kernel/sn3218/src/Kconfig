## package/kernel/sn3218/src/Kconfig
```kconfig
config SN3218
	tristate "LED support for Si-En SN3218 I2C chip"
	depends on LEDS_CLASS && I2C
	depends on OF
	help
	  This option enables support for the Si-EN SN3218 LED driver
	  through I2C. Say Y to enable support for the SN3218 LED.
```
